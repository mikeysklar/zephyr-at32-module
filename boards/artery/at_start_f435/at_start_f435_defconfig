## boards/artery/at_start_f435/at_start_f435_defconfig
```kconfig
# SPDX-License-Identifier: Apache-2.0

# Enable Reset
CONFIG_RESET=y

# Enable GPIO
CONFIG_GPIO=y

# console
CONFIG_SERIAL=y
CONFIG_CONSOLE=y
CONFIG_UART_CONSOLE=y
```

## boards/artery/at_start_f435/board.yml
```yaml
board:
  name: at_start_f435
  full_name: AT-START-F435
  vendor: artery
  socs:
    - name: at32f435
```

## drivers/Kconfig
```kconfig
# SPDX-License-Identifier: Apache-2.0

if CLOCK_CONTROL
rsource "clock_control/Kconfig"
endif

if GPIO
rsource "gpio/Kconfig"
endif

if PINCTRL
rsource "pinctrl/Kconfig"
endif

if RESET
rsource "reset/Kconfig"
endif

rsource "interrupt_controller/Kconfig"

if SERIAL
rsource "serial/Kconfig"
endif

if FLASH
rsource "flash/Kconfig"
endif

if DMA
rsource "dma/Kconfig"
endif

if ADC
rsource "adc/Kconfig"
endif

if PWM
rsource "pwm/Kconfig"
endif

if I2C
rsource "i2c/Kconfig"
endif

if SPI
rsource "spi/Kconfig"
endif

if COUNTER
rsource "counter/Kconfig"
endif
```

## dts/bindings/flash_controller/artery,at32-flash-controller.yaml
```yaml
description: AT32 flash controller

compatible: "artery,at32-flash-controller"

include: flash-controller.yaml
```

## dts/bindings/mtd/artery,at32-nv-flash-v1.yaml
```yaml
description: |
  AT32 V1 flash memory.

include: artery,at32-nv-flash.yaml

compatible: artery,at32-nv-flash-v1
```

## dts/bindings/watchdog/artery,at32-window-watchdog.yaml
```yaml
# Copyright (c) 2019 Centaur Analytics, Inc
# SPDX-License-Identifier: Apache-2.0

description: AT32 system window watchdog

compatible: "artery,at32-window-watchdog"

include: base.yaml

properties:
  reg:
    required: true

  clocks:
    required: true
```
